/* http_server.c - HTTP(S) file server backed by the embedded zip.
 *
 * Thin esp_http_server adapter over the platform-neutral wk_http core:
 *   - resolves the entry + streams it via wk_http_serve_get,
 *   - HEAD returns the same headers without a body,
 *   - 404/500 map wk_http status codes onto httpd errors.
 *
 * For the host unit tests, tools/tests/esp_http_server_stub.c provides the
 * esp_http_server symbols; this file's handlers are exercised end to end
 * through a captured request/response mock. Handler entry points are
 * declared weak so tests can substitute where the stub lacks coverage.
 */
#include <string.h>
#include <stdio.h>
#include <stdlib.h>
#include "esp_log.h"
#include "esp_https_server.h"
#include "http_server.h"
#include "wk_http.h"
#include "wk_connectivity.h"

static const char *TAG = "web";

/* Generated by tools/gen_ssl_cert.py. EMBED_TXTFILES adds the terminating NUL;
 * the start/end lengths below must include it for mbedTLS PEM parsing. */
extern const uint8_t servercert_start[] asm("_binary_servercert_pem_start");
extern const uint8_t servercert_end[] asm("_binary_servercert_pem_end");
extern const uint8_t prvtkey_start[] asm("_binary_prvtkey_pem_start");
extern const uint8_t prvtkey_end[] asm("_binary_prvtkey_pem_end");

/* Mirrors build_host.py's FORCE_EXPLOIT default ("relapse"). */
static const char selected_exploit[] = CONFIG_WKAL_SELECTED_EXPLOIT "\n";

/* ------------------------------------------------------------------ */
/* esp_http_server I/O sink over wk_http_io_t                          */

typedef struct {
    httpd_req_t *req;
    bool ok;
    bool begun;
} resp_sink_t;

static bool sink_begin(void *ctx, const char *ctype, uint32_t body_len,
                       const char *name, bool streamed)
{
    resp_sink_t *s = ctx;
    (void)name;
    (void)streamed;
    (void)body_len;
    s->begun = true;
    /* send_chunk supplies Transfer-Encoding. Adding Content-Length would
     * produce contradictory HTTP framing; IDF also retains header pointers. */
    return httpd_resp_set_type(s->req, ctype) == ESP_OK;
}

static bool sink_write(void *ctx, const uint8_t *data, size_t len)
{
    resp_sink_t *s = ctx;
    if (httpd_resp_send_chunk(s->req, (const char *)data, len) != ESP_OK) {
        s->ok = false;
        return false;
    }
    return true;
}

static void sink_end(void *ctx)
{
    resp_sink_t *s = ctx;
    if (s->ok && httpd_resp_send_chunk(s->req, NULL, 0) != ESP_OK) s->ok = false;
}

static const wk_http_io_t resp_io = {
    .begin = sink_begin,
    .write = sink_write,
    .end = sink_end,
};

/* ------------------------------------------------------------------ */

static bool send_bytes(httpd_req_t *req, const char *data, size_t length)
{
    while (length) {
        int sent = httpd_send(req, data, length);
        if (sent <= 0) return false;
        data += sent;
        length -= (size_t)sent;
    }
    return true;
}

/* Fixed framing matches the reference reachability/speed-test endpoints.
 * The 6 MB test uses 1 KB of read-only storage, without any large allocation. */
static esp_err_t send_probe(httpd_req_t *req, const char *body,
                            uint32_t length, bool head)
{
    static const char zeros[1024] = {0};
    char headers[192];
    int n = snprintf(headers, sizeof(headers),
                     "HTTP/1.1 200 OK\r\nContent-Type: text/plain\r\n"
                     "Content-Length: %u\r\nCache-Control: no-store\r\n\r\n",
                     (unsigned)length);
    if (n < 0 || n >= (int)sizeof(headers) ||
        !send_bytes(req, headers, (size_t)n)) return ESP_FAIL;
    if (head) return ESP_OK;
    if (body) return send_bytes(req, body, length) ? ESP_OK : ESP_FAIL;
    while (length) {
        size_t chunk = length < sizeof(zeros) ? length : sizeof(zeros);
        if (!send_bytes(req, zeros, chunk)) return ESP_FAIL;
        length -= chunk;
    }
    return ESP_OK;
}

/* Weak: the host test stub overrides this with its own dispatch. */
__attribute__((weak)) esp_err_t wk_httpd_handle_get(httpd_req_t *req, web_server_t *srv)
{
    const char *body;
    uint32_t length;
    if (wk_connectivity_probe(req->uri, false, &body, &length))
        return send_probe(req, body, length, false);
    if (!srv || !srv->zip) {
        httpd_resp_send_err(req, HTTPD_404_NOT_FOUND,
                            "frontend.zip not found on storage");
        return ESP_FAIL;
    }
    resp_sink_t sink = { .req = req, .ok = true };
    wk_http_status_t rc = wk_http_serve_get(srv->zip, req->uri,
                                            selected_exploit, &resp_io, &sink);
    switch (rc) {
    case WK_HTTP_OK:
        return sink.ok ? ESP_OK : ESP_FAIL;
    case WK_HTTP_NOT_FOUND:
    case WK_HTTP_BAD_URI:
        httpd_resp_send_err(req, HTTPD_404_NOT_FOUND, "Not found");
        return ESP_FAIL;
    case WK_HTTP_INTERNAL:
        /* A partial stream must be closed, never followed by a second response. */
        if (!sink.begun) httpd_resp_send_500(req);
        return ESP_FAIL;
    case WK_HTTP_ABORTED:
    default:
        return ESP_FAIL;
    }
}

static esp_err_t handle_get(httpd_req_t *req)
{
    ESP_LOGI(TAG, "GET %s", req->uri);
    esp_err_t result = wk_httpd_handle_get(req, req->user_ctx);
    ESP_LOGI(TAG, "GET completed: %s", esp_err_to_name(result));
    return result;
}

/* HEAD: headers only, mirrors SimpleHTTPRequestHandler's HEAD support. */
esp_err_t wk_httpd_handle_head(httpd_req_t *req, web_server_t *srv)
{
    const char *body;
    uint32_t length;
    if (wk_connectivity_probe(req->uri, false, &body, &length))
        return send_probe(req, body, length, true);
    if (!srv || !srv->zip) {
        httpd_resp_send_err(req, HTTPD_404_NOT_FOUND, "Not found");
        return ESP_FAIL;
    }
    /* IDF emits Content-Length: 0 for resp_send(NULL, 0). Send HEAD's
     * complete header block through the session transport, including TLS. */
    char rel[256];
    const wk_zip_entry_t *e = NULL;
    uint32_t body_len = 0;
    const char *ctype = "text/plain";
    const char *query = strchr(req->uri, '?');
    size_t path_len = query ? (size_t)(query - req->uri) : strlen(req->uri);
    bool virtual_file = path_len >= 16 &&
                        memcmp(req->uri + path_len - 16, "selected_exploit", 16) == 0;
    if (wk_zip_map_path(req->uri, rel, sizeof(rel))) {
        e = wk_zip_find(srv->zip, rel);
        if (!e && (rel[0] == '\0' || rel[strlen(rel) - 1] == '/')) {
            char cand[256 + 10];
            if (snprintf(cand, sizeof(cand), "%sindex.html", rel) < (int)sizeof(cand))
                e = wk_zip_find(srv->zip, cand);
            if (!e && snprintf(cand, sizeof(cand), "%sindex.htm", rel) < (int)sizeof(cand))
                e = wk_zip_find(srv->zip, cand);
        }
    }
    if (virtual_file) {
        body_len = sizeof(selected_exploit) - 1;
    } else if (e) {
        body_len = e->uncomp_size;
        ctype = wk_http_content_type(e->name);
    } else {
        httpd_resp_send_err(req, HTTPD_404_NOT_FOUND, "Not found");
        return ESP_FAIL;
    }
    char headers[192];
    int len = snprintf(headers, sizeof(headers),
                       "HTTP/1.1 200 OK\r\nContent-Type: %s\r\nContent-Length: %u\r\n\r\n",
                       ctype, (unsigned)body_len);
    if (len < 0 || len >= (int)sizeof(headers)) return ESP_FAIL;
    int sent = 0;
    while (sent < len) {
        int n = httpd_send(req, headers + sent, len - sent);
        if (n <= 0) return ESP_FAIL;
        sent += n;
    }
    return ESP_OK;
}

static esp_err_t handle_head(httpd_req_t *req)
{
    return wk_httpd_handle_head(req, req->user_ctx);
}

esp_err_t wk_httpd_handle_post(httpd_req_t *req)
{
    const char *body;
    uint32_t length;
    if (!wk_connectivity_probe(req->uri, true, &body, &length)) {
        httpd_resp_send_err(req, HTTPD_404_NOT_FOUND, "Not found");
        return ESP_FAIL;
    }
    if (req->content_len > 131072u) {
        httpd_resp_send_err(req, HTTPD_400_BAD_REQUEST, "Upload test exceeds 128 KiB");
        return ESP_FAIL;
    }
    /* Drain the bounded request body so the next keep-alive request is valid. */
    char discard[512];
    size_t remaining = req->content_len;
    while (remaining) {
        size_t chunk = remaining < sizeof(discard) ? remaining : sizeof(discard);
        int received = httpd_req_recv(req, discard, chunk);
        if (received <= 0) return ESP_FAIL; /* SDK closes failed sessions. */
        remaining -= (size_t)received;
    }
    ESP_LOGI(TAG, "POST network test: %u bytes", (unsigned)req->content_len);
    return send_probe(req, body, length, false);
}

static const httpd_uri_t uri_get = {
    .uri = "*",
    .method = HTTP_GET,
    .handler = handle_get,
};

static const httpd_uri_t uri_head = {
    .uri = "*",
    .method = HTTP_HEAD,
    .handler = handle_head,
};

static const httpd_uri_t uri_post = {
    .uri = "*",
    .method = HTTP_POST,
    .handler = wk_httpd_handle_post,
};

/* ------------------------------------------------------------------ */

int web_server_start(web_server_t *srv, const wk_zip_t *zip)
{
    srv->zip = zip;

    /* Plain HTTP on 80. */
    httpd_config_t cfg = HTTPD_DEFAULT_CONFIG();
    cfg.server_port = 80;
    cfg.max_uri_handlers = 8;
    cfg.stack_size = 8192;
    cfg.uri_match_fn = httpd_uri_match_wildcard;
    if (httpd_start(&srv->http, &cfg) == ESP_OK) {
        httpd_uri_t g = uri_get;
        g.user_ctx = srv;
        httpd_register_uri_handler(srv->http, &g);
        httpd_uri_t h = uri_head;
        h.user_ctx = srv;
        httpd_register_uri_handler(srv->http, &h);
        httpd_register_uri_handler(srv->http, &uri_post);
        ESP_LOGI(TAG, "HTTP server on :80");
    } else {
        ESP_LOGW(TAG, "HTTP server failed to start");
        srv->http = NULL;
    }

    /* HTTPS on 443 with the embedded self-signed cert. */
    httpd_ssl_config_t scfg = HTTPD_SSL_CONFIG_DEFAULT();
    scfg.servercert = servercert_start;
    scfg.servercert_len = servercert_end - servercert_start;
    scfg.prvtkey_pem = prvtkey_start;
    scfg.prvtkey_len = prvtkey_end - prvtkey_start;
    scfg.httpd.max_uri_handlers = 8;
    scfg.httpd.stack_size = 12288;
    scfg.httpd.uri_match_fn = httpd_uri_match_wildcard;
    /* This setting controls the server task stack, not TLS allocations. */
    scfg.httpd.task_caps = MALLOC_CAP_INTERNAL | MALLOC_CAP_8BIT;

    esp_err_t err = httpd_ssl_start(&srv->https, &scfg);
    if (err == ESP_OK) {
        httpd_uri_t g = uri_get;
        g.user_ctx = srv;
        httpd_register_uri_handler(srv->https, &g);
        httpd_uri_t h = uri_head;
        h.user_ctx = srv;
        httpd_register_uri_handler(srv->https, &h);
        httpd_register_uri_handler(srv->https, &uri_post);
        ESP_LOGI(TAG, "HTTPS server on :443");
    } else {
        ESP_LOGW(TAG, "HTTPS server failed to start (0x%x)", err);
        srv->https = NULL;
    }
    return srv->https ? 0 : -1;
}
