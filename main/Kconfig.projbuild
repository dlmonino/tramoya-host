## main/Kconfig.projbuild
```kconfig
menu "Servidor TRAMOYA"

    config WKAL_TARGET_DOMAIN
        string "Dominio DNS de destino"
        default "manuals.playstation.net"
        help
            Dominio que resuelve la PS5 al abrir la Guía del usuario.
            Las consultas A reciben la IP del AP; los dominios ajenos
            reciben NXDOMAIN.

    config WKAL_STORAGE_PARTITION
        string "Nombre de la partición de almacenamiento"
        default "storage"

    config WKAL_STORAGE_MOUNT_PATH
        string "Ruta de montaje del almacenamiento FAT"
        default "/msc"

    config WKAL_STORAGE_ZIP_NAME
        string "Nombre del ZIP del frontend en el almacenamiento"
        default "frontend.zip"

    config WKAL_SELECTED_EXPLOIT
        string "Exploit predeterminado para firmwares con soporte doble"
        default "relapse"
        help
            Se sirve en /selected_exploit; app.js lo lee en firmwares
            que admiten poops y relapse (7.00-12.00). Equivale al valor
            FORCE_EXPLOIT del servidor para ordenador.

endmenu
```
